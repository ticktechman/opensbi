## platform/hawks/configs/defconfig
```kconfig
#
# Platform Options
#
CONFIG_PLATFORM_TEMPLATE=y
# end of Platform Options

#
# Generic SBI Support
#
CONFIG_CONSOLE_EARLY_BUFFER_SIZE=256
CONFIG_SBI_ECALL_TIME=y
CONFIG_SBI_ECALL_RFENCE=y
CONFIG_SBI_ECALL_IPI=y
# CONFIG_SBI_ECALL_HSM is not set
# CONFIG_SBI_ECALL_SRST is not set
# CONFIG_SBI_ECALL_SUSP is not set
# CONFIG_SBI_ECALL_PMU is not set
CONFIG_SBI_ECALL_DBCN=y
# CONFIG_SBI_ECALL_CPPC is not set
# CONFIG_SBI_ECALL_FWFT is not set
CONFIG_SBI_ECALL_LEGACY=y
# CONFIG_SBI_ECALL_VENDOR is not set
# CONFIG_SBI_ECALL_DBTR is not set
# CONFIG_SBIUNIT is not set
# CONFIG_SBI_ECALL_SSE is not set
# CONFIG_SBI_ECALL_MPXY is not set
# end of Generic SBI Support

#
# Utils and Drivers Support
#

#
# Cache Support
#
# CONFIG_CACHE is not set
# end of Cache Support

#
# CPPC Device Support
#
# end of CPPC Device Support

# CONFIG_FDT is not set

#
# GPIO Support
#
# CONFIG_GPIO is not set
# end of GPIO Support

#
# HSM Device Support
#
# end of HSM Device Support

#
# I2C Support
#
# CONFIG_I2C_DW is not set
# CONFIG_I2C is not set
# end of I2C Support

#
# IPI Device Support
#
CONFIG_IPI_MSWI=y
# CONFIG_IPI_PLICSW is not set
# end of IPI Device Support

#
# Interrupt Controller Support
#
# CONFIG_IRQCHIP_APLIC is not set
# CONFIG_IRQCHIP_IMSIC is not set
CONFIG_IRQCHIP_PLIC=y
# end of Interrupt Controller Support

#
# Mailbox Support
#
# CONFIG_RPMI_MAILBOX is not set
# CONFIG_MAILBOX is not set
# end of Mailbox Support

#
# Regmap Support
#
# CONFIG_REGMAP is not set
# end of Regmap Support

#
# System Reset Support
#
# end of System Reset Support

#
# Serial Device Support
#
# CONFIG_SERIAL_CADENCE is not set
# CONFIG_SERIAL_GAISLER is not set
# CONFIG_SERIAL_RENESAS_SCIF is not set
# CONFIG_SERIAL_SHAKTI is not set
# CONFIG_SERIAL_SIFIVE is not set
CONFIG_SERIAL_LITEX=y
CONFIG_SERIAL_UART8250=y
# CONFIG_SERIAL_XILINX_UARTLITE is not set
# CONFIG_SERIAL_SEMIHOSTING is not set
# end of Serial Device Support

#
# System Suspend Support
#
# end of System Suspend Support

#
# System Device Support
#
# CONFIG_SYS_ATCSMU is not set
# CONFIG_SYS_HTIF is not set
# end of System Device Support

#
# Timer Device Support
#
CONFIG_TIMER_MTIMER=y
# CONFIG_TIMER_PLMT is not set
# end of Timer Device Support

#
# MPXY Device Support
#
# end of MPXY Device Support
# end of Utils and Drivers Support

#
# Stack Protector Support
#
# CONFIG_STACK_PROTECTOR is not set
# end of Stack Protector Support
```
